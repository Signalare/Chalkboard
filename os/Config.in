## os/Config.in
```kconfig
# SPDX-License-Identifier: MIT OR Apache-2.0
source "$BR2_EXTERNAL_CHALKBOARD_PATH/package/cb-spike-tools/Config.in"
source "$BR2_EXTERNAL_CHALKBOARD_PATH/package/cb-rpi-eeprom/Config.in"
source "$BR2_EXTERNAL_CHALKBOARD_PATH/package/chalkboard-render/Config.in"
```

## os/configs/chalkboard_defconfig
```kconfig
# SPDX-License-Identifier: MIT OR Apache-2.0
#
# Universal aarch64 OS image configuration for Chalkboard (OS-001..OS-004).
# Produces dual A/B slots, dm-verity, and serves all supported Raspberry Pi boards.

BR2_aarch64=y
BR2_cortex_a53=y
BR2_ARM_FPU_VFPV4=y
BR2_TOOLCHAIN_EXTERNAL=y
BR2_TOOLCHAIN_EXTERNAL_BOOTLIN=y
BR2_TOOLCHAIN_EXTERNAL_BOOTLIN_AARCH64_GLIBC_STABLE=y
BR2_GLOBAL_PATCH_DIR="board/raspberrypi/patches"
BR2_DOWNLOAD_FORCE_CHECK_HASHES=y

BR2_TARGET_GENERIC_HOSTNAME="chalkboard"
BR2_TARGET_GENERIC_ISSUE="Chalkboard OS (Milestone 0.1)"
BR2_TARGET_GENERIC_ROOT_PASSWD=""
BR2_TARGET_GENERIC_GETTY_PORT="ttyAMA0"
BR2_TARGET_GENERIC_GETTY_BAUDRATE_115200=y
BR2_ROOTFS_OVERLAY="$(BR2_EXTERNAL_CHALKBOARD_PATH)/board/chalkboard/rootfs-overlay"
BR2_ROOTFS_POST_BUILD_SCRIPT="$(BR2_EXTERNAL_CHALKBOARD_PATH)/board/chalkboard/post-build.sh"
BR2_ROOTFS_POST_IMAGE_SCRIPT="$(BR2_EXTERNAL_CHALKBOARD_PATH)/board/chalkboard/post-image.sh"

BR2_LINUX_KERNEL=y
BR2_LINUX_KERNEL_CUSTOM_TARBALL=y
BR2_LINUX_KERNEL_CUSTOM_TARBALL_LOCATION="$(call github,raspberrypi,linux,21b410140c47ffab5668399f6f143c7d7b935c8b)/linux-21b410140c47ffab5668399f6f143c7d7b935c8b.tar.gz"
BR2_LINUX_KERNEL_DEFCONFIG="bcm2711"
BR2_LINUX_KERNEL_CONFIG_FRAGMENT_FILES="$(BR2_EXTERNAL_CHALKBOARD_PATH)/board/chalkboard/linux.fragment"
BR2_LINUX_KERNEL_DTS_SUPPORT=y
BR2_LINUX_KERNEL_INTREE_DTS_NAME="broadcom/bcm2710-rpi-3-b broadcom/bcm2710-rpi-3-b-plus broadcom/bcm2710-rpi-zero-2-w broadcom/bcm2711-rpi-4-b broadcom/bcm2711-rpi-400 broadcom/bcm2711-rpi-cm4 broadcom/bcm2712-rpi-5-b broadcom/bcm2712-rpi-cm5-cm5io"
BR2_LINUX_KERNEL_NEEDS_HOST_OPENSSL=y

BR2_PACKAGE_BUSYBOX_CONFIG_FRAGMENT_FILES="$(BR2_EXTERNAL_CHALKBOARD_PATH)/board/chalkboard/busybox.fragment"
BR2_PACKAGE_BUSYBOX_SHOW_OTHERS=y
BR2_PACKAGE_BASH=y
BR2_PACKAGE_DOSFSTOOLS=y
BR2_PACKAGE_DOSFSTOOLS_FSCK_FAT=y
BR2_PACKAGE_F2FS_TOOLS=y
BR2_PACKAGE_XZ=y
BR2_PACKAGE_KMOD=y
BR2_PACKAGE_KMOD_TOOLS=y
BR2_PACKAGE_CB_SPIKE_TOOLS=y
BR2_PACKAGE_RPI_FIRMWARE=y
BR2_PACKAGE_RPI_FIRMWARE_BOOTCODE_BIN=y
BR2_PACKAGE_RPI_FIRMWARE_VARIANT_PI=y
BR2_PACKAGE_RPI_FIRMWARE_VARIANT_PI4=y
BR2_PACKAGE_BRCMFMAC_SDIO_FIRMWARE_RPI=y
BR2_PACKAGE_BRCMFMAC_SDIO_FIRMWARE_RPI_WIFI=y
BR2_PACKAGE_WIRELESS_REGDB=y
BR2_PACKAGE_WPA_SUPPLICANT=y
BR2_PACKAGE_RPI_FIRMWARE_CONFIG_FILE="$(BR2_EXTERNAL_CHALKBOARD_PATH)/board/chalkboard/config.txt"
BR2_PACKAGE_CB_RPI_EEPROM=y
BR2_PACKAGE_CB_RPI_EEPROM_CONFIG_FILE="$(BR2_EXTERNAL_CHALKBOARD_PATH)/board/chalkboard/bootconf.txt"

BR2_TARGET_ROOTFS_SQUASHFS=y
BR2_TARGET_ROOTFS_SQUASHFS_XZ=y
# BR2_TARGET_ROOTFS_TAR is not set
BR2_PACKAGE_HOST_DOSFSTOOLS=y
BR2_PACKAGE_HOST_GENIMAGE=y
BR2_PACKAGE_HOST_KMOD_XZ=y
BR2_PACKAGE_HOST_MTOOLS=y
BR2_PACKAGE_HOST_SQUASHFS=y
BR2_PACKAGE_HOST_F2FS_TOOLS=y
```

## os/package/cb-rpi-eeprom/Config.in
```kconfig
# SPDX-License-Identifier: MIT OR Apache-2.0
config BR2_PACKAGE_CB_RPI_EEPROM
	bool "cb-rpi-eeprom"
	help
	  Raspberry Pi 4 EEPROM bootloader update (OS-011): the official
	  bootloader image from the rpi-eeprom "default" release channel with
	  a Chalkboard bootloader configuration embedded, plus the official
	  recovery.bin that flashes it from the boot partition.

if BR2_PACKAGE_CB_RPI_EEPROM

config BR2_PACKAGE_CB_RPI_EEPROM_CONFIG_FILE
	string "bootloader configuration file"
	help
	  Bootloader configuration (bootconf.txt syntax) to embed.

endif
```

## os/package/cb-spike-tools/Config.in
```kconfig
# SPDX-License-Identifier: MIT OR Apache-2.0
config BR2_PACKAGE_CB_SPIKE_TOOLS
	bool "cb-spike-tools"
	help
	  Boot-slot spike tools (#3): cb-firstframe draws a first frame via
	  DRM/KMS and prints a timing marker; cb-tryboot, cb-slot and
	  cb-commit exercise the A/B slot mechanisms.
```

## os/package/chalkboard-render/Config.in
```kconfig
# SPDX-License-Identifier: MIT OR Apache-2.0
config BR2_PACKAGE_CHALKBOARD_RENDER
	bool "chalkboard-render"
	help
	  Chalkboard DRM/KMS and headless digital signage renderer (RND-001, RND-005).
```
